/*@!Encoding:1252*/
includes
{
  
}

variables
{
  
}

on message ACCInfo
{
  switch(this.ACCDriverInf)
  {
    case 0:
            sysSetVariableString(sysvar::ACCSystem::Dimmessages,"ACC OFF");
            break;
    case 1:
             sysSetVariableString(sysvar::ACCSystem::Dimmessages,"ACC ON");
            break;
    case 2:
             sysSetVariableString(sysvar::ACCSystem::Dimmessages,"ACC STANDBY");
            break;
    case 3:
             sysSetVariableString(sysvar::ACCSystem::Dimmessages,"ACC ACTIVE");
            break;
    case 4:
            sysSetVariableString(sysvar::ACCSystem::Dimmessages,"ACC FAULT");
            break;
    case 5:
            sysSetVariableString(sysvar::ACCSystem::Dimmessages,"Driver Intervention Required");
            break;
    case 6:
            //sysSetVariableString(sysvar::ACCSystem::Dimmessages,"ACC OFF");
            break;
    case 7:
            //sysSetVariableString(sysvar::ACCSystem::Dimmessages,"ACC OFF");
            break;
  }
  
}

