/*@!Encoding:1252*/
includes
{
  
}

variables
{
  int setSpeed;
  int currentVehicleSpeed;
  int brk_SW1,brk_SW2;
  timer one_sec;
}



on start
{
  setTimer(one_sec,1);
}


on timer one_sec
{
  if(getSignal(ACCInfo::TargetSpeed) < currentVehicleSpeed && getSignal(ACCInfo::ACCState) ==3)
  {
    setSignal(ACCInfo::BrakeDecelReques,1);
    
  }
  else
  {
     setSignal(ACCInfo::BrakeDecelReques,0);
  }
  setTimer(one_sec,1);
  
}

on sysvar ACCSystem::IG_Key
{
  if(@this == 0)
  {
    setSignal(ACCInfo::ACCState,0);
    setSignal(ACCInfo::ACCDriverInf,0);
    setSignal(ACCInfo::TargetSpeed,0);
    @sysvar::ACCSystem::ACC_Fault = 0; 
    
  }
}


on sysvar ACCSystem::ACC_Fault
{
  if(@this)
  {
  setSignal(ACCInfo::ACCState,4);
  setSignal(ACCInfo::ACCDriverInf,4);
  setSignal(ACCInfo::TargetSpeed,0);
  }
  else
  {
    setSignal(ACCInfo::ACCState,0);
    setSignal(ACCInfo::ACCDriverInf,0);
  }
}

on sysvar ACCSystem::ForwordVehicleStatus
{
  int target_Speed;
  if(@this)
  {
    target_Speed = @sysvar::ACCSystem::Clearance/@sysvar::ACCSystem::TimeGap;
    setSignal(ACCInfo::TargetSpeed,target_Speed);
    
  }
  else
  {
     setSignal(ACCInfo::TargetSpeed,setSpeed);
  }
    
}


on sysvar ACCSystem::BrakePedal
{
  if(@this)
  {
    setSignal(ACCInfo::ACCState,0);
    setSignal(ACCInfo::ACCDriverInf,0);
    setSignal(ACCInfo::TargetSpeed,0);
  }
}

on message ICMInfo
{
  switch(this.CruiseSwitchRequest)
  {
    case 0: 
            setSignal(ACCInfo::ACCState,0);
            setSignal(ACCInfo::ACCDriverInf,0);
            break;
    case 1:
            if(getSignal(ACCInfo::ACCState) != 4)
            {
            setSignal(ACCInfo::ACCState, 2);
            setSignal(ACCInfo::ACCDriverInf,2);
            }
            break;
    case 2:
            if(getSignal(ACCInfo::ACCState)==2 && brk_SW1 == 0 && brk_SW2 ==0 && currentVehicleSpeed >= 40)
            {
              if(setSpeed==0)
               {
                setSpeed =currentVehicleSpeed;
               }
              write(" The vehilce setspeed =%d",setSpeed);
              setSignal(ACCInfo::TargetSpeed,setSpeed);
              setSignal(ACCInfo::ACCState,3);
              setSignal(ACCInfo::ACCDriverInf,3);
            }
            
            break;
    case 3:
            break;
      
    case 4:
            if(getSignal(ACCInfo::ACCState)==2)
            {
              if(setSpeed==0)
               {
                setSpeed =currentVehicleSpeed;
               }
              currentVehicleSpeed = setSpeed;
              //write(" The vehilce setspeed =%d",setSpeed);
              setSignal(ACCInfo::TargetSpeed,setSpeed);
              setSignal(ACCInfo::ACCState,3);
              setSignal(ACCInfo::ACCDriverInf,3);
            }
            break;
      
     case 5:
            @sysvar::ACCSystem::TimeGap=@sysvar::ACCSystem::TimeGap + 0.0027;
            break;
      
     case 6:
            @sysvar::ACCSystem::TimeGap=@sysvar::ACCSystem::TimeGap - 0.0027;
            break;
            
  }
  brk_SW1 =this.BrakeSwitch1;
  if(this.BrakeSwitch1 ==1 && getSignal(ACCInfo::ACCState)==3) 
  {
   setSignal(ACCInfo::ACCState,2);
   setSignal(ACCInfo::ACCDriverInf,2);
  }
  
  
}
//due to this message coming from another ECU, So we arecreating another  another on message event handle
on message ECMInfo
{
  if(this.BrakeSwitch2 ==1 && getSignal(ACCInfo::ACCState)==3) 
  {
   setSignal(ACCInfo::ACCState,2);
   setSignal(ACCInfo::ACCDriverInf,2);
  }
  brk_SW2 =this.BrakeSwitch2;
}


on message BCMInfo
{
  currentVehicleSpeed=getSignal(BCMInfo::VehicleSpeed);
  if(getSignal(ACCInfo::ACCState) ==3 && currentVehicleSpeed < 40)
  {
    setSignal(ACCInfo::ACCState,2);
    setSignal(ACCInfo::ACCDriverInf,5);
    msgBeep(5);
    
    
  }
  
}

