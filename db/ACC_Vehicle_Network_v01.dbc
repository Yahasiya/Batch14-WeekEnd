VERSION ""

NS_ :

BS_:

BU_: ECM BCM ACC ICM
VAL_TABLE_ Brakedeccel 1 "Apply" 0 "Do not Apply" ;
VAL_TABLE_ ACCState 4 "Fault" 3 "Active" 2 "Stand by" 1 "ON" 0 "OFF" ;
VAL_TABLE_ BrakeSwSt 1 "Pressed" 0 "NotPressed" ;
VAL_TABLE_ CruiseSwstates 7 "None" 6 "TimeGap -" 5 "TimeGap +" 4 "Resume" 3 "Coast" 2 "Set/Accel" 1 "ON" 0 "OFF" ;

BO_ 3221225472 VECTOR__INDEPENDENT_SIG_MSG: 0 Vector__XXX
 SG_ ACCDriverInfo : 0|3@1+ (1,0) [0|0] "" Vector__XXX
 SG_ BrakeDecelRequest : 0|1@1+ (1,0) [0|0] "" Vector__XXX
 SG_ VehicleSpeed : 0|8@1+ (1,0) [0|0] "" Vector__XXX
 SG_ TargetSpeed : 0|8@1+ (1,0) [0|0] "km/h" Vector__XXX
 SG_ ACCState : 0|3@1+ (1,0) [0|0] "" Vector__XXX
 SG_ BrakeSwitch2 : 0|1@1+ (1,0) [0|0] "" Vector__XXX
 SG_ BrakeSwitch1 : 0|1@1+ (1,0) [0|0] "" Vector__XXX
 SG_ CruiseSwitchRequest : 0|3@1+ (1,0) [0|0] "" Vector__XXX

CM_ BO_ 3221225472 "This is a message for not used signals, created by Vector CANdb++ DBC OLE DB Provider.";
BA_DEF_ SG_  "GenSigStartValue" INT 0 0;
BA_DEF_  "BusType" STRING ;
BA_DEF_DEF_  "GenSigStartValue" 0;
BA_DEF_DEF_  "BusType" "CAN";
BA_ "GenSigStartValue" SG_ 3221225472 CruiseSwitchRequest 7;
VAL_ 3221225472 BrakeDecelRequest 1 "Apply" 0 "Do not Apply" ;
VAL_ 3221225472 BrakeSwitch2 1 "Pressed" 0 "NotPressed" ;
VAL_ 3221225472 BrakeSwitch1 1 "Pressed" 0 "NotPressed" ;
VAL_ 3221225472 CruiseSwitchRequest 7 "None" 6 "TimeGap -" 5 "TimeGap +" 4 "Resume" 3 "Coast" 2 "Set/Accel" 1 "ON" 0 "OFF" ;
